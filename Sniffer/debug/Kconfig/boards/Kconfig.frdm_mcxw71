## Sniffer/debug/Kconfig/boards/Kconfig.frdm_mcxw71
```kconfig
# Load board Kconfig descriptions.
osource "G:/zephyr_v4_1_0/zephyr/boards/nxp/frdm_mcxw71/Kconfig.frdm_mcxw71"
```

## Sniffer/debug/Kconfig/soc/Kconfig
```kconfig
# Load Zephyr SoC Kconfig descriptions.
osource "G:/zephyr_v4_1_0/zephyr/soc/xlnx/zynqmp/Kconfig"
osource "G:/zephyr_v4_1_0/zephyr/soc/xlnx/zynq7000/Kconfig"
osource "G:/zephyr_v4_1_0/zephyr/soc/xen/Kconfig"
osource "G:/zephyr_v4_1_0/zephyr/soc/wch/ch32v/Kconfig"
osource "G:/zephyr_v4_1_0/zephyr/soc/ti/simplelink/Kconfig"
osource "G:/zephyr_v4_1_0/zephyr/soc/ti/lm3s6965/Kconfig"
osource "G:/zephyr_v4_1_0/zephyr/soc/ti/k3/Kconfig"
osource "G:/zephyr_v4_1_0/zephyr/soc/telink/tlsr/Kconfig"
osource "G:/zephyr_v4_1_0/zephyr/soc/starfive/jh71xx/Kconfig"
osource "G:/zephyr_v4_1_0/zephyr/soc/st/stm32/Kconfig"
osource "G:/zephyr_v4_1_0/zephyr/soc/snps/qemu_arc/Kconfig"
osource "G:/zephyr_v4_1_0/zephyr/soc/snps/nsim/arc_v/Kconfig"
osource "G:/zephyr_v4_1_0/zephyr/soc/snps/nsim/arc_classic/Kconfig"
osource "G:/zephyr_v4_1_0/zephyr/soc/snps/hsdk4xd/Kconfig"
osource "G:/zephyr_v4_1_0/zephyr/soc/snps/hsdk/Kconfig"
osource "G:/zephyr_v4_1_0/zephyr/soc/snps/emsk/Kconfig"
osource "G:/zephyr_v4_1_0/zephyr/soc/snps/emsdp/Kconfig"
osource "G:/zephyr_v4_1_0/zephyr/soc/snps/arc_iot/Kconfig"
osource "G:/zephyr_v4_1_0/zephyr/soc/silabs/Kconfig"
osource "G:/zephyr_v4_1_0/zephyr/soc/sifive/sifive_freedom/Kconfig"
osource "G:/zephyr_v4_1_0/zephyr/soc/sensry/Kconfig"
osource "G:/zephyr_v4_1_0/zephyr/soc/rockchip/Kconfig"
osource "G:/zephyr_v4_1_0/zephyr/soc/renode/riscv_virtual/Kconfig"
osource "G:/zephyr_v4_1_0/zephyr/soc/renode/cortex_r8_virtual/Kconfig"
osource "G:/zephyr_v4_1_0/zephyr/soc/renesas/smartbond/Kconfig"
osource "G:/zephyr_v4_1_0/zephyr/soc/renesas/rzt2m/Kconfig"
osource "G:/zephyr_v4_1_0/zephyr/soc/renesas/rz/Kconfig"
osource "G:/zephyr_v4_1_0/zephyr/soc/renesas/rcar/Kconfig"
osource "G:/zephyr_v4_1_0/zephyr/soc/renesas/ra/Kconfig"
osource "G:/zephyr_v4_1_0/zephyr/soc/realtek/ec/Kconfig"
osource "G:/zephyr_v4_1_0/zephyr/soc/raspberrypi/rpi_pico/Kconfig"
osource "G:/zephyr_v4_1_0/zephyr/soc/quicklogic/eos_s3/Kconfig"
osource "G:/zephyr_v4_1_0/zephyr/soc/qemu/virt_riscv/Kconfig"
osource "G:/zephyr_v4_1_0/zephyr/soc/qemu/malta/Kconfig"
osource "G:/zephyr_v4_1_0/zephyr/soc/openisa/rv32m1/Kconfig"
osource "G:/zephyr_v4_1_0/zephyr/soc/nxp/s32/Kconfig"
osource "G:/zephyr_v4_1_0/zephyr/soc/nxp/rw/Kconfig"
osource "G:/zephyr_v4_1_0/zephyr/soc/nxp/mcx/Kconfig"
osource "G:/zephyr_v4_1_0/zephyr/soc/nxp/lpc/Kconfig"
osource "G:/zephyr_v4_1_0/zephyr/soc/nxp/layerscape/Kconfig"
osource "G:/zephyr_v4_1_0/zephyr/soc/nxp/kinetis/Kconfig"
osource "G:/zephyr_v4_1_0/zephyr/soc/nxp/imxrt/Kconfig"
osource "G:/zephyr_v4_1_0/zephyr/soc/nxp/imx/Kconfig"
osource "G:/zephyr_v4_1_0/zephyr/soc/nuvoton/numicro/Kconfig"
osource "G:/zephyr_v4_1_0/zephyr/soc/nuvoton/numaker/Kconfig"
osource "G:/zephyr_v4_1_0/zephyr/soc/nuvoton/npcx/Kconfig"
osource "G:/zephyr_v4_1_0/zephyr/soc/nuvoton/npcm/Kconfig"
osource "G:/zephyr_v4_1_0/zephyr/soc/nordic/Kconfig"
osource "G:/zephyr_v4_1_0/zephyr/soc/neorv32/Kconfig"
osource "G:/zephyr_v4_1_0/zephyr/soc/native/inf_clock/Kconfig"
osource "G:/zephyr_v4_1_0/zephyr/soc/microchip/miv/Kconfig"
osource "G:/zephyr_v4_1_0/zephyr/soc/microchip/mec/Kconfig"
osource "G:/zephyr_v4_1_0/zephyr/soc/mediatek/mt8xxx/Kconfig"
osource "G:/zephyr_v4_1_0/zephyr/soc/lowrisc/opentitan/Kconfig"
osource "G:/zephyr_v4_1_0/zephyr/soc/litex/litex_vexriscv/Kconfig"
osource "G:/zephyr_v4_1_0/zephyr/soc/ite/ec/Kconfig"
osource "G:/zephyr_v4_1_0/zephyr/soc/intel/raptor_lake/Kconfig"
osource "G:/zephyr_v4_1_0/zephyr/soc/intel/lakemont/Kconfig"
osource "G:/zephyr_v4_1_0/zephyr/soc/intel/intel_socfpga_std/Kconfig"
osource "G:/zephyr_v4_1_0/zephyr/soc/intel/intel_socfpga/Kconfig"
osource "G:/zephyr_v4_1_0/zephyr/soc/intel/intel_niosv/Kconfig"
osource "G:/zephyr_v4_1_0/zephyr/soc/intel/intel_ish/Kconfig"
osource "G:/zephyr_v4_1_0/zephyr/soc/intel/intel_adsp/Kconfig"
osource "G:/zephyr_v4_1_0/zephyr/soc/intel/elkhart_lake/Kconfig"
osource "G:/zephyr_v4_1_0/zephyr/soc/intel/atom/Kconfig"
osource "G:/zephyr_v4_1_0/zephyr/soc/intel/apollo_lake/Kconfig"
osource "G:/zephyr_v4_1_0/zephyr/soc/intel/alder_lake/Kconfig"
osource "G:/zephyr_v4_1_0/zephyr/soc/infineon/cat3/Kconfig"
osource "G:/zephyr_v4_1_0/zephyr/soc/infineon/cat1b/Kconfig"
osource "G:/zephyr_v4_1_0/zephyr/soc/infineon/cat1a/Kconfig"
osource "G:/zephyr_v4_1_0/zephyr/soc/gd/gd32/Kconfig"
osource "G:/zephyr_v4_1_0/zephyr/soc/gaisler/leon3/Kconfig"
osource "G:/zephyr_v4_1_0/zephyr/soc/gaisler/gr716a/Kconfig"
osource "G:/zephyr_v4_1_0/zephyr/soc/espressif/Kconfig"
osource "G:/zephyr_v4_1_0/zephyr/soc/ene/kb1200/Kconfig"
osource "G:/zephyr_v4_1_0/zephyr/soc/efinix/sapphire/Kconfig"
osource "G:/zephyr_v4_1_0/zephyr/soc/cdns/xtensa_sample_controller/Kconfig"
osource "G:/zephyr_v4_1_0/zephyr/soc/cdns/sample_controller32/Kconfig"
osource "G:/zephyr_v4_1_0/zephyr/soc/cdns/dc233c/Kconfig"
osource "G:/zephyr_v4_1_0/zephyr/soc/brcm/bcmvk/Kconfig"
osource "G:/zephyr_v4_1_0/zephyr/soc/brcm/bcm2712/Kconfig"
osource "G:/zephyr_v4_1_0/zephyr/soc/brcm/bcm2711/Kconfig"
osource "G:/zephyr_v4_1_0/zephyr/soc/atmel/sam0/Kconfig"
osource "G:/zephyr_v4_1_0/zephyr/soc/atmel/sam/Kconfig"
osource "G:/zephyr_v4_1_0/zephyr/soc/aspeed/Kconfig"
osource "G:/zephyr_v4_1_0/zephyr/soc/arm/Kconfig"
osource "G:/zephyr_v4_1_0/zephyr/soc/arm/beetle/Kconfig"
osource "G:/zephyr_v4_1_0/zephyr/soc/antmicro/myra/Kconfig"
osource "G:/zephyr_v4_1_0/zephyr/soc/andestech/Kconfig"
osource "G:/zephyr_v4_1_0/zephyr/soc/amd/acp_6_0/Kconfig"
osource "G:/zephyr_v4_1_0/zephyr/soc/ambiq/Kconfig"
osource "G:/zephyr_v4_1_0/zephyr/soc/altr/zephyr_nios2f/Kconfig"
osource "G:/zephyr_v4_1_0/zephyr/soc/altr/qemu_nios2/Kconfig"
osource "G:/zephyr_v4_1_0/zephyr/soc/adi/max32/Kconfig"
```

## Sniffer/debug/Sniffer/Kconfig/arch/Kconfig
```kconfig
# Load Zephyr Arch Kconfig descriptions.
osource "G:/zephyr_v4_1_0/zephyr/arch/x86/Kconfig"
osource "G:/zephyr_v4_1_0/zephyr/arch/xtensa/Kconfig"
osource "G:/zephyr_v4_1_0/zephyr/arch/sparc/Kconfig"
osource "G:/zephyr_v4_1_0/zephyr/arch/riscv/Kconfig"
osource "G:/zephyr_v4_1_0/zephyr/arch/posix/Kconfig"
osource "G:/zephyr_v4_1_0/zephyr/arch/nios2/Kconfig"
osource "G:/zephyr_v4_1_0/zephyr/arch/mips/Kconfig"
osource "G:/zephyr_v4_1_0/zephyr/arch/arm64/Kconfig"
osource "G:/zephyr_v4_1_0/zephyr/arch/arm/Kconfig"
osource "G:/zephyr_v4_1_0/zephyr/arch/arc/Kconfig"
```

## Sniffer/debug/Sniffer/Kconfig/boards/Kconfig.defconfig
```kconfig
# Load Zephyr board defconfig descriptions.
osource "G:/zephyr_v4_1_0/zephyr/boards/nxp/frdm_mcxw71/Kconfig.defconfig"
```

## debug/Kconfig/arch/Kconfig
```kconfig
# Load Zephyr Arch Kconfig descriptions.
osource "G:/zephyr_v4_2_0_rc1/zephyr/arch/rx/Kconfig"
osource "G:/zephyr_v4_2_0_rc1/zephyr/arch/x86/Kconfig"
osource "G:/zephyr_v4_2_0_rc1/zephyr/arch/xtensa/Kconfig"
osource "G:/zephyr_v4_2_0_rc1/zephyr/arch/sparc/Kconfig"
osource "G:/zephyr_v4_2_0_rc1/zephyr/arch/riscv/Kconfig"
osource "G:/zephyr_v4_2_0_rc1/zephyr/arch/posix/Kconfig"
osource "G:/zephyr_v4_2_0_rc1/zephyr/arch/mips/Kconfig"
osource "G:/zephyr_v4_2_0_rc1/zephyr/arch/arm64/Kconfig"
osource "G:/zephyr_v4_2_0_rc1/zephyr/arch/arm/Kconfig"
osource "G:/zephyr_v4_2_0_rc1/zephyr/arch/arc/Kconfig"
```

## debug/Kconfig/boards/Kconfig.sysbuild
```kconfig
# Load Sysbuild board Kconfig descriptions.
osource "G:/zephyr_v4_2_0_rc1/zephyr/boards/nxp/frdm_mcxw71/Kconfig.sysbuild"
```
